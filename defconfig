## defconfig
```kconfig
BR2_KERNEL_HEADERS_5_9=y
BR2_GCC_VERSION_10_X=y
BR2_SYSTEM_DHCP="eth0"
BR2_ROOTFS_OVERLAY="../rootfs_overlay"
BR2_LINUX_KERNEL=y
BR2_LINUX_KERNEL_USE_CUSTOM_CONFIG=y
BR2_LINUX_KERNEL_CUSTOM_CONFIG_FILE="../.config.linux"
BR2_PACKAGE_BUSYBOX_CONFIG="../.config.busybox"
BR2_PACKAGE_DROPBEAR=y
BR2_TARGET_ROOTFS_CPIO=y
# BR2_TARGET_ROOTFS_TAR is not set
```
